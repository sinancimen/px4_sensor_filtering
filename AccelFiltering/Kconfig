## AccelFiltering/Kconfig
```kconfig
menuconfig MODULES_ACCEL_FILTERING
	bool "accel_filtering"
	default n
	---help---
		Enable support for accel_filtering
```

## GyroFiltering/Kconfig
```kconfig
menuconfig MODULES_GYRO_FILTERING
	bool "gyro_filtering"
	default n
	---help---
		Enable support for gyro_filtering
```
